## conf/layer.conf
```bitbake
# We have a conf and classes directory, add to BBPATH
BBPATH .= ":${LAYERDIR}"

# We have recipes-* directories, add to BBFILES
BBFILES += "${LAYERDIR}/recipes-*/*/*.bb \
            ${LAYERDIR}/recipes-*/*/*.bbappend"

BBFILE_COLLECTIONS += "meta-yoctolab"
BBFILE_PATTERN_meta-yoctolab = "^${LAYERDIR}/"
BBFILE_PRIORITY_meta-yoctolab = "6"

LAYERDEPENDS_meta-yoctolab = "core"
LAYERSERIES_COMPAT_meta-yoctolab = "kirkstone"
```
